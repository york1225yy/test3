## SMP_Linux_GCC_musl (3)/SMP_Linux_GCC_musl/01.software/board/Hi3516CV610_SDK_V1.0.1.0/Hi3516CV610_SDK_V1.0.1.0/package/smp/a7_linux/source/bsp/tools/pc/image_tree_source/linux_image_quickstart.its
```
/dts-v1/;

/ {
	description = "Linux Kernel";
	#address-cells = <1>;

	images {

		linux_kernel {
			description = "Linux";
			data = /incbin/("./Image");
			type = "kernel";
			arch = "arm";
			os = "Linux";
			compression = "none";
			load = <0x40008000>;
			entry = <0x40008000>;
		};

		fdt-1 {
			description = "dtb";
			data = /incbin/("./devicetree.dtb");
			type = "flat_dt";
			arch = "arm";
			compression = "none";
		};

	};

	configurations {
		default = "config-1";
		config-1 {
			description = "Linux";
			kernel = "linux_kernel";
			fdt = "fdt-1";
		};
	};
};
```
